## CMakeLists.txt
```
cmake_minimum_required(VERSION 3.28.0)
find_package(Zephyr REQUIRED HINTS $ENV{ZEPHYR_BASE})
project(ciso LANGUAGES C)
set_property(TARGET subsys__canbus__isotp PROPERTY SOURCES ${CMAKE_CURRENT_SOURCE_DIR}/vendor/isotp.c)
target_include_directories(subsys__canbus__isotp PRIVATE include vendor)
target_include_directories(app PRIVATE include vendor)
target_sources(app PRIVATE src/service.c src/usb.c src/main.c)
```

## prj.conf
```kconfig
# SPDX-License-Identifier: Apache-2.0
CONFIG_CAN=y
CONFIG_CAN_FD_MODE=n
CONFIG_ISOTP=y
CONFIG_ISOTP_ENABLE_CONTEXT_BUFFERS=n
CONFIG_ISOTP_RX_BUF_COUNT=8
CONFIG_ISOTP_RX_BUF_SIZE=512
CONFIG_ISOTP_RX_SF_FF_BUF_COUNT=2
CONFIG_USB_DEVICE_STACK_NEXT=y
CONFIG_HWINFO=y
CONFIG_BOOT_BANNER=n
CONFIG_PRINTK=n
CONFIG_LOG=n
CONFIG_MAIN_STACK_SIZE=1536
CONFIG_SYSTEM_WORKQUEUE_STACK_SIZE=1024
CONFIG_LTO=y
CONFIG_ISR_TABLES_LOCAL_DECLARATION=y
CONFIG_STACK_SENTINEL=y
CONFIG_UDC_BUF_COUNT=16
CONFIG_UDC_BUF_POOL_SIZE=1024
```

## boards/mks_canable_v20_stm32g431xx.overlay
```dts
/* SPDX-License-Identifier: Apache-2.0 */
/* CANnectivity's MKS board uses the board's fixed FDCAN pinctrl.
 * Dedicated diagnostic USB mode deliberately has no gs_usb node.
 */
```

## src/main.c
```c
/* SPDX-License-Identifier: Apache-2.0 */
#include "service.h"
#include <zephyr/devicetree.h>
int main(void)
{
    const struct device *can = DEVICE_DT_GET(DT_CHOSEN(zephyr_canbus));
    if (!device_is_ready(can)) { return -ENODEV; }
    ciso_init(can, ciso_usb_write);
    int err = ciso_usb_init();
    if (err) { return err; }
    bool previous = false;
    for (;;) {
        bool enabled = ciso_usb_enabled();
        if (previous && !enabled) { ciso_link_lost(); }
        previous = enabled;
        struct net_buf *buf = ciso_usb_read(K_MSEC(1));
        if (buf) {
            if (enabled) { ciso_feed(buf->data, buf->len); }
            ciso_usb_read_done(buf);
        }
        ciso_poll();
    }
}
```

## include/ciso_isotp.h
```c
/* Modified by CANable VCI contributors; see firmware/vendor/PROVENANCE.md. */
/*
 * Copyright (c) 2019 Alexander Wachter
 *
 * SPDX-License-Identifier: Apache-2.0
 */

/**
 * @file
 * @brief Public API for ISO-TP (ISO 15765-2:2016)
 *
 * ISO-TP is a transport protocol for CAN (Controller Area Network)
 */

#ifndef ZEPHYR_INCLUDE_CANBUS_ISOTP_H_
#define ZEPHYR_INCLUDE_CANBUS_ISOTP_H_

/**
 * @brief CAN ISO-TP Protocol
 * @defgroup can_isotp CAN ISO-TP Protocol
 * @ingroup connectivity
 * @since 2.2
 * @version 1.0.0
 * @{
 */

#include <zephyr/drivers/can.h>
#include <zephyr/types.h>
#include <zephyr/net_buf.h>

/*
 * Abbreviations
 * BS      Block Size
 * CAN_DL  CAN LL data size
 * CF      Consecutive Frame
 * CTS     Continue to send
 * DLC     Data length code
 * FC      Flow Control
 * FF      First Frame
 * SF      Single Frame
 * FS      Flow Status
 * AE      Address Extension
 * SN      Sequence Number
 * ST      Separation time
 * SA      Source Address
 * TA      Target Address
 * RX_DL   CAN RX LL data size
 * TX_DL   CAN TX LL data size
 * PCI     Process Control Information
 */

/*
 * N_Result according to ISO 15765-2:2016
 * ISOTP_ prefix is used to be zephyr conform
 */

/** Completed successfully */
#define ISOTP_N_OK              0

/** Ar/As has timed out */
#define ISOTP_N_TIMEOUT_A      -1

/** Reception of next FC has timed out */
#define ISOTP_N_TIMEOUT_BS     -2

/** Cr has timed out */
#define ISOTP_N_TIMEOUT_CR     -3

/** Unexpected sequence number */
#define ISOTP_N_WRONG_SN       -4

/** Invalid flow status received*/
#define ISOTP_N_INVALID_FS     -5

/** Unexpected PDU received */
#define ISOTP_N_UNEXP_PDU      -6

/** Maximum number of WAIT flowStatus PDUs exceeded */
#define ISOTP_N_WFT_OVRN       -7

/** FlowStatus OVFLW PDU was received */
#define ISOTP_N_BUFFER_OVERFLW -8

/** General error */
#define ISOTP_N_ERROR          -9

/** Implementation specific errors */

/** Can't bind or send because the CAN device has no filter left*/
#define ISOTP_NO_FREE_FILTER    -10

/** No net buffer left to allocate */
#define ISOTP_NO_NET_BUF_LEFT   -11

/** Not sufficient space in the buffer left for the data */
#define ISOTP_NO_BUF_DATA_LEFT  -12

/** No context buffer left to allocate */
#define ISOTP_NO_CTX_LEFT       -13

/** Timeout for recv */
#define ISOTP_RECV_TIMEOUT      -14

/*
 * CAN ID filtering for ISO-TP fixed addressing according to SAE J1939
 *
 * Format of 29-bit CAN identifier:
 * ------------------------------------------------------
 * | 28 .. 26 | 25  | 24 | 23 .. 16 | 15 .. 8  | 7 .. 0 |
 * ------------------------------------------------------
 * | Priority | EDP | DP | N_TAtype |   N_TA   |  N_SA  |
 * ------------------------------------------------------
 */

/** Position of fixed source address (SA) */
#define ISOTP_FIXED_ADDR_SA_POS         (CONFIG_ISOTP_FIXED_ADDR_SA_POS)

/** Mask to obtain fixed source address (SA) */
#define ISOTP_FIXED_ADDR_SA_MASK        (CONFIG_ISOTP_FIXED_ADDR_SA_MASK)

/** Position of fixed target address (TA) */
#define ISOTP_FIXED_ADDR_TA_POS         (CONFIG_ISOTP_FIXED_ADDR_TA_POS)

/** Mask to obtain fixed target address (TA) */
#define ISOTP_FIXED_ADDR_TA_MASK        (CONFIG_ISOTP_FIXED_ADDR_TA_MASK)

/** Position of priority in fixed addressing mode */
#define ISOTP_FIXED_ADDR_PRIO_POS       (CONFIG_ISOTP_FIXED_ADDR_PRIO_POS)

/** Mask for priority in fixed addressing mode */
#define ISOTP_FIXED_ADDR_PRIO_MASK      (CONFIG_ISOTP_FIXED_ADDR_PRIO_MASK)

/** CAN filter RX mask to match any priority and source address (SA) */
#define ISOTP_FIXED_ADDR_RX_MASK        (CONFIG_ISOTP_FIXED_ADDR_RX_MASK)

#ifdef __cplusplus
extern "C" {
#endif

/**
 * @name ISO-TP message ID flags
 * @anchor ISOTP_MSG_FLAGS
 *
 * @{
 */

/** Message uses ISO-TP extended addressing (first payload byte of CAN frame) */
#define ISOTP_MSG_EXT_ADDR BIT(0)

/**
 * Message uses ISO-TP fixed addressing (according to SAE J1939). Only valid in combination with
 * ``ISOTP_MSG_IDE``.
 */
#define ISOTP_MSG_FIXED_ADDR BIT(1)

/** Message uses extended (29-bit) CAN ID */
#define ISOTP_MSG_IDE BIT(2)

/** Message uses CAN FD format (FDF) */
#define ISOTP_MSG_FDF BIT(3)

/** Message uses CAN FD Baud Rate Switch (BRS). Only valid in combination with ``ISOTP_MSG_FDF``. */
#define ISOTP_MSG_BRS BIT(4)

/** @} */

/**
 * @brief ISO-TP message id struct
 *
 * Used to pass addresses to the bind and send functions.
 */
struct isotp_msg_id {
	/**
	 * CAN identifier
	 *
	 * If ISO-TP fixed addressing is used, isotp_bind ignores SA and
	 * priority sections and modifies TA section in flow control frames.
	 */
	union {
		uint32_t std_id  : 11;
		uint32_t ext_id  : 29;
	};
	/** ISO-TP extended address (if used) */
	uint8_t ext_addr;
	/**
	 * ISO-TP frame data length (TX_DL for TX address or RX_DL for RX address).
	 *
	 * Valid values are 8 for classical CAN or 8, 12, 16, 20, 24, 32, 48 and 64 for CAN FD.
	 *
	 * 0 will be interpreted as 8 or 64 (if ISOTP_MSG_FDF is set).
	 *
	 * The value for incoming transmissions (RX_DL) is determined automatically based on the
	 * received first frame and does not need to be set during initialization.
	 */
	uint8_t dl;
	/** Flags. @see @ref ISOTP_MSG_FLAGS. */
	uint8_t flags;
};

/*
 * STmin is split in two valid ranges:
 *   0-127: 0ms-127ms
 * 128-240: Reserved
 * 241-249: 100us-900us (multiples of 100us)
 * 250-   : Reserved
 */

/**
 * @brief ISO-TP frame control options struct
 *
 * Used to pass the options to the bind and send functions.
 */
struct isotp_fc_opts {
	uint8_t bs;    /**< Block size. Number of CF PDUs before next CF is sent */
	uint8_t stmin; /**< Minimum separation time. Min time between frames */
};

/**
 * @brief Transmission callback
 *
 * This callback is called when a transmission is completed.
 *
 * @param error_nr ISOTP_N_OK on success, ISOTP_N_* on error
 * @param arg      Callback argument passed to the send function
 */
typedef void (*isotp_tx_callback_t)(int error_nr, void *arg);

struct isotp_send_ctx;
struct isotp_recv_ctx;

/**
 * @brief Bind an address to a receiving context.
 *
 * This function binds an RX and TX address combination to an RX context.
 * When data arrives from the specified address, it is buffered and can be read
 * by calling isotp_recv.
 * When calling this routine, a filter is applied in the CAN device, and the
 * context is initialized. The context must be valid until calling unbind.
 *
 * @param rctx    Context to store the internal states.
 * @param can_dev The CAN device to be used for sending and receiving.
 * @param rx_addr Identifier for incoming data.
 * @param tx_addr Identifier for FC frames.
 * @param opts    Flow control options.
 * @param timeout Timeout for FF SF buffer allocation.
 *
 * @retval ISOTP_N_OK on success
 * @retval ISOTP_NO_FREE_FILTER if CAN device has no filters left.
 */
int isotp_bind(struct isotp_recv_ctx *rctx, const struct device *can_dev,
	       const struct isotp_msg_id *rx_addr,
	       const struct isotp_msg_id *tx_addr,
	       const struct isotp_fc_opts *opts,
	       k_timeout_t timeout);

/**
 * @brief Unbind a context from the interface
 *
 * This function removes the binding from isotp_bind.
 * The filter is detached from the CAN device, and if a transmission is ongoing,
 * buffers are freed.
 * The context can be discarded safely after calling this function.
 *
 * @param rctx    Context that should be unbound.
 */
void isotp_unbind(struct isotp_recv_ctx *rctx);

/**
 * @brief Read out received data from fifo.
 *
 * This function reads the data from the receive FIFO of the context.
 * It blocks if the FIFO is empty.
 * If an error occurs, the function returns a negative number and leaves the
 * data buffer unchanged.
 *
 * @param rctx    Context that is already bound.
 * @param data    Pointer to a buffer where the data is copied to.
 * @param len     Size of the buffer.
 * @param timeout Timeout for incoming data.
 *
 * @return Number of bytes copied on success
 * @retval ISOTP_RECV_TIMEOUT when "timeout" timed out
 * @retval ISOTP_N_* on error
 */
int isotp_recv(struct isotp_recv_ctx *rctx, uint8_t *data, size_t len, k_timeout_t timeout);

/**
 * @brief Get the net buffer on data reception
 *
 * This function reads incoming data into net-buffers.
 * It blocks until the entire packet is received, BS is reached, or an error
 * occurred. If BS was zero, the data is in a single net_buf. Otherwise,
 * the data is fragmented in chunks of BS size.
 * The net-buffers are referenced and must be freed with net_buf_unref after the
 * data is processed.
 *
 * @param rctx    Context that is already bound.
 * @param buffer  Pointer where the net_buf pointer is written to.
 * @param timeout Timeout for incoming data.
 *
 * @return Remaining data length for this transfer if BS > 0, 0 for BS = 0
 * @retval ISOTP_RECV_TIMEOUT when "timeout" timed out
 * @retval ISOTP_N_* on error
 */
int isotp_recv_net(struct isotp_recv_ctx *rctx, struct net_buf **buffer, k_timeout_t timeout);

/**
 * @brief Send data
 *
 * This function is used to send data to a peer that listens to the tx_addr.
 * An internal work-queue is used to transfer the segmented data.
 * Data and context must be valid until the transmission has finished.
 * If a complete_cb is given, this function is non-blocking, and the callback
 * is called on completion with the return value as a parameter.
 *
 * @param sctx        Context to store the internal states.
 * @param can_dev     The CAN device to be used for sending and receiving.
 * @param data        Data to be sent.
 * @param len         Length of the data to be sent.
 * @param rx_addr     Identifier for FC frames.
 * @param tx_addr     Identifier for outgoing frames the receiver listens on.
 * @param complete_cb Function called on completion or NULL.
 * @param cb_arg      Argument passed to the complete callback.
 *
 * @retval ISOTP_N_OK on success
 * @retval ISOTP_N_* on error
 */
int isotp_send(struct isotp_send_ctx *sctx, const struct device *can_dev,
	       const uint8_t *data, size_t len,
	       const struct isotp_msg_id *tx_addr,
	       const struct isotp_msg_id *rx_addr,
	       isotp_tx_callback_t complete_cb, void *cb_arg);

#ifdef CONFIG_ISOTP_ENABLE_CONTEXT_BUFFERS
/**
 * @brief Send data with buffered context
 *
 * This function is similar to isotp_send, but the context is automatically
 * allocated from an internal pool.
 *
 * @param can_dev     The CAN device to be used for sending and receiving.
 * @param data        Data to be sent.
 * @param len         Length of the data to be sent.
 * @param rx_addr     Identifier for FC frames.
 * @param tx_addr     Identifier for outgoing frames the receiver listens on.
 * @param complete_cb Function called on completion or NULL.
 * @param cb_arg      Argument passed to the complete callback.
 * @param timeout     Timeout for buffer allocation.
 *
 * @retval ISOTP_N_OK on success
 * @retval ISOTP_N_* on error
 */
int isotp_send_ctx_buf(const struct device *can_dev,
		       const uint8_t *data, size_t len,
		       const struct isotp_msg_id *tx_addr,
		       const struct isotp_msg_id *rx_addr,
		       isotp_tx_callback_t complete_cb, void *cb_arg,
		       k_timeout_t timeout);

/**
 * @brief Send data with buffered context
 *
 * This function is similar to isotp_send_ctx_buf, but the data is carried in
 * a net_buf. net_buf_unref is called on the net_buf when sending is completed.
 *
 * @param can_dev     The CAN device to be used for sending and receiving.
 * @param data        Data to be sent.
 * @param len         Length of the data to be sent.
 * @param rx_addr     Identifier for FC frames.
 * @param tx_addr     Identifier for outgoing frames the receiver listens on.
 * @param complete_cb Function called on completion or NULL.
 * @param cb_arg      Argument passed to the complete callback.
 * @param timeout     Timeout for buffer allocation.
 *
 * @retval ISOTP_N_OK on success
 * @retval ISOTP_* on error
 */
int isotp_send_net_ctx_buf(const struct device *can_dev,
			   struct net_buf *data,
			   const struct isotp_msg_id *tx_addr,
			   const struct isotp_msg_id *rx_addr,
			   isotp_tx_callback_t complete_cb, void *cb_arg,
			   k_timeout_t timeout);

#endif /*CONFIG_ISOTP_ENABLE_CONTEXT_BUFFERS*/

#if defined(CONFIG_ISOTP_USE_TX_BUF) && \
	defined(CONFIG_ISOTP_ENABLE_CONTEXT_BUFFERS)
/**
 * @brief Send data with buffered context
 *
 * This function is similar to isotp_send, but the context is automatically
 * allocated from an internal pool and the data to be send is buffered in an
 * internal net_buff.
 *
 * @param can_dev     The CAN device to be used for sending and receiving.
 * @param data        Data to be sent.
 * @param len         Length of the data to be sent.
 * @param rx_addr     Identifier for FC frames.
 * @param tx_addr     Identifier for outgoing frames the receiver listens on.
 * @param complete_cb Function called on completion or NULL.
 * @param cb_arg      Argument passed to the complete callback.
 * @param timeout     Timeout for buffer allocation.
 *
 * @retval ISOTP_N_OK on success
 * @retval ISOTP_* on error
 */
int isotp_send_buf(const struct device *can_dev,
		   const uint8_t *data, size_t len,
		   const struct isotp_msg_id *tx_addr,
		   const struct isotp_msg_id *rx_addr,
		   isotp_tx_callback_t complete_cb, void *cb_arg,
		   k_timeout_t timeout);
#endif

/** @cond INTERNAL_HIDDEN */

struct isotp_callback {
	isotp_tx_callback_t cb;
	void *arg;
};

struct isotp_send_ctx {
	/* Optional persistent receiver; caller keeps it bound until TX quiesces. */
	struct isotp_recv_ctx *fc_receiver;
	atomic_t pending_frames;
	uint64_t can_started_us;
	atomic_t cancel_requested;
	atomic_t can_error;
	int filter_id;
	uint32_t error_nr;
	const struct device *can_dev;
	union {
		struct net_buf *buf;
		struct {
			const uint8_t *data;
			size_t len;
		};
	};
	struct k_work work;
	struct k_timer timer;
	union {
		struct isotp_callback fin_cb;
		struct k_sem fin_sem;
	};
	struct isotp_fc_opts opts;
	uint8_t state;
	uint8_t tx_backlog;
	struct k_sem tx_sem;
	struct isotp_msg_id rx_addr;
	struct isotp_msg_id tx_addr;
	uint8_t wft;
	uint8_t bs;
	uint8_t sn : 4;
	uint8_t is_net_buf  : 1;
	uint8_t is_ctx_slab : 1;
	uint8_t has_callback: 1;
};

struct isotp_recv_ctx {
	atomic_t resetting;
	struct isotp_send_ctx *fc_sender;
	uint32_t ciso_transfer;
	uint32_t ciso_status;
	uint64_t ciso_time_us;
	int filter_id;
	const struct device *can_dev;
	struct net_buf *buf;
	struct net_buf *act_frag;
	/* buffer currently processed in isotp_recv */
	struct net_buf *recv_buf;
	sys_snode_t alloc_node;
	uint32_t length;
	int error_nr;
	struct k_work work;
	struct k_timer timer;
	struct k_fifo fifo;
	struct isotp_msg_id rx_addr;
	struct isotp_msg_id tx_addr;
	struct isotp_fc_opts opts;
	uint8_t state;
	uint8_t bs;
	uint8_t wft;
	uint8_t sn_expected : 4;
};

/* Project-specific hooks. The protocol service implements these. */
bool ciso_rx_accept(struct isotp_recv_ctx *ctx, uint32_t length, bool multi);
void ciso_rx_failed(struct isotp_recv_ctx *ctx, int error);
void ciso_isotp_cancel(struct isotp_send_ctx *ctx);
/* Reset application RX storage while preserving FC delivery for active TX. */
int ciso_isotp_reset_rx(struct isotp_recv_ctx *rx);
/* Pair idle, persistent contexts after bind; unbind only after TX quiesces. */
void ciso_isotp_share_rx(struct isotp_recv_ctx *rx, struct isotp_send_ctx *tx);
/** @endcond */

/**
 * @}
 */

#ifdef __cplusplus
}
#endif

#endif /* ZEPHYR_INCLUDE_CANBUS_ISOTP_H_ */
```

## include/service.h
```c
/* SPDX-License-Identifier: Apache-2.0 */
#pragma once
#include <zephyr/device.h>
#include <zephyr/kernel.h>
#include <zephyr/net_buf.h>
#include <stdint.h>
#include <stddef.h>
typedef int (*ciso_write_fn)(const uint8_t *bytes, size_t length);
void ciso_init(const struct device *can, ciso_write_fn write_fn);
void ciso_feed(const uint8_t *bytes, size_t length);
void ciso_poll(void);
void ciso_link_lost(void);
int ciso_usb_init(void);
struct net_buf *ciso_usb_read(k_timeout_t timeout);
void ciso_usb_read_done(struct net_buf *buf);
int ciso_usb_write(const uint8_t *bytes, size_t length);
bool ciso_usb_enabled(void);
```

## src/usb.c
```c
/* Modified by CANable VCI contributors; see firmware/vendor/PROVENANCE.md. */
/* Derived from CANnectivity USB setup and Zephyr's loopback class.
 * Copyright (c) 2024-2026 Henrik Brix Andersen;
 * Copyright (c) 2022, 2025 Nordic Semiconductor ASA.
 * SPDX-License-Identifier: Apache-2.0 */
#include "service.h"
#include <zephyr/usb/usbd.h>
#include <zephyr/usb/msos_desc.h>
#include <zephyr/drivers/usb/udc.h>
#include <zephyr/sys/byteorder.h>
#include <string.h>
static struct {
    struct usb_if_descriptor interface;
    struct usb_ep_descriptor out, in;
    struct usb_desc_header end;
} desc={
    .interface={.bLength=sizeof(struct usb_if_descriptor),.bDescriptorType=USB_DESC_INTERFACE,
                .bNumEndpoints=2,.bInterfaceClass=0xff,.bInterfaceSubClass=0x49,.bInterfaceProtocol=1},
    .out={.bLength=sizeof(struct usb_ep_descriptor),.bDescriptorType=USB_DESC_ENDPOINT,
          .bEndpointAddress=0x01,.bmAttributes=USB_EP_TYPE_BULK,.wMaxPacketSize=64},
    .in={.bLength=sizeof(struct usb_ep_descriptor),.bDescriptorType=USB_DESC_ENDPOINT,
         .bEndpointAddress=0x81,.bmAttributes=USB_EP_TYPE_BULK,.wMaxPacketSize=64},
};
static const struct usb_desc_header *const descriptors[]={
    (void*)&desc.interface,(void*)&desc.out,(void*)&desc.in,(void*)&desc.end
};
static struct usbd_class_data *class_data;
static atomic_t enabled, in_error;
K_FIFO_DEFINE(out_fifo);
K_SEM_DEFINE(in_done,0,1);
static int out_start(void)
{
    if(!atomic_get(&enabled)) { return -ENODEV; }
    struct net_buf *buf=usbd_ep_buf_alloc(class_data,desc.out.bEndpointAddress,64);
    if(!buf) { return -ENOMEM; }
    int err=usbd_ep_enqueue(class_data,buf);
    if(err) { net_buf_unref(buf); }
    return err;
}
static int request(struct usbd_class_data *data, struct net_buf *buf, int err)
{
    ARG_UNUSED(data);
    if(udc_get_buf_info(buf)->ep==desc.out.bEndpointAddress) {
        if(!err && atomic_get(&enabled)) { k_fifo_put(&out_fifo,buf); }
        else { net_buf_unref(buf); }
    } else {
        atomic_set(&in_error,err); net_buf_unref(buf); k_sem_give(&in_done);
    }
    return 0;
}
static const void *get_desc(struct usbd_class_data *data, enum usbd_speed speed)
{
    ARG_UNUSED(data); ARG_UNUSED(speed); return descriptors;
}
static void enable(struct usbd_class_data *data)
{
    class_data=data; atomic_set(&enabled,1); out_start();
}
static void disable(struct usbd_class_data *data)
{
    atomic_clear(&enabled);
    usbd_ep_dequeue(usbd_class_get_ctx(data),desc.in.bEndpointAddress);
    usbd_ep_dequeue(usbd_class_get_ctx(data),desc.out.bEndpointAddress);
    struct net_buf *buf;
    while((buf=k_fifo_get(&out_fifo,K_NO_WAIT))) { net_buf_unref(buf); }
    atomic_set(&in_error,-ENODEV); k_sem_give(&in_done);
}
static int class_init(struct usbd_class_data *data)
{
    class_data=data;
    return 0;
}
static const struct usbd_class_api api={.init=class_init,.request=request,.get_desc=get_desc,.enable=enable,.disable=disable};
USBD_DEFINE_CLASS(ciso_0,&api,NULL,NULL);
/* Generic pid.codes test PID, private development only. */
USBD_DEVICE_DEFINE(device,DEVICE_DT_GET(DT_NODELABEL(zephyr_udc0)),0x1209,0x0001);
USBD_DESC_LANG_DEFINE(lang);
USBD_DESC_MANUFACTURER_DEFINE(manufacturer,"CANable VCI development");
USBD_DESC_PRODUCT_DEFINE(product,"CANable ISO-TP development");
USBD_DESC_SERIAL_NUMBER_DEFINE(serial);
USBD_DESC_CONFIG_DEFINE(config_desc,"ISO-TP diagnostic interface");
USBD_CONFIGURATION_DEFINE(config,0,125,&config_desc);
static const struct usb_bos_capability_lpm usb_extension={
    .bLength=sizeof(struct usb_bos_capability_lpm),
    .bDescriptorType=USB_DESC_DEVICE_CAPABILITY,
    .bDevCapabilityType=USB_BOS_CAPABILITY_EXTENSION,
    .bmAttributes=0,
};
USBD_DESC_BOS_DEFINE(usbext,sizeof(usb_extension),&usb_extension);
struct os_descriptor {
    struct msosv2_descriptor_set_header header;
    struct msosv2_compatible_id compatible;
    struct msosv2_guids_property guid;
    struct msosv2_vendor_revision revision;
} __packed;
static struct os_descriptor os={
    .header={.wLength=sizeof(struct msosv2_descriptor_set_header),
             .wDescriptorType=MS_OS_20_SET_HEADER_DESCRIPTOR,.dwWindowsVersion=0x06030000,
             .wTotalLength=sizeof(struct os_descriptor)},
    .compatible={.wLength=sizeof(struct msosv2_compatible_id),.wDescriptorType=MS_OS_20_FEATURE_COMPATIBLE_ID,
                 .CompatibleID={'W','I','N','U','S','B',0,0}},
    .guid={.wLength=sizeof(struct msosv2_guids_property),.wDescriptorType=MS_OS_20_FEATURE_REG_PROPERTY,
           .wPropertyDataType=MS_OS_20_PROPERTY_DATA_REG_MULTI_SZ,.wPropertyNameLength=42,
           .PropertyName={DEVICE_INTERFACE_GUIDS_PROPERTY_NAME},.wPropertyDataLength=80},
    .revision={.wLength=sizeof(struct msosv2_vendor_revision),.wDescriptorType=MS_OS_20_FEATURE_VENDOR_REVISION,
               .VendorRevision=1},
};
struct bos_msos { struct usb_bos_platform_descriptor platform; struct usb_bos_capability_msos cap; } __packed;
static const struct bos_msos bos={
    .platform={.bLength=sizeof(struct bos_msos),.bDescriptorType=USB_DESC_DEVICE_CAPABILITY,
               .bDevCapabilityType=USB_BOS_CAPABILITY_PLATFORM,
               .PlatformCapabilityUUID={0xdf,0x60,0xdd,0xd8,0x89,0x45,0xc7,0x4c,0x9c,0xd2,0x65,0x9d,0x9e,0x64,0x8a,0x9f}},
    .cap={.dwWindowsVersion=0x06030000,.wMSOSDescriptorSetTotalLength=sizeof(struct os_descriptor),.bMS_VendorCode=0x20},
};
static struct net_buf *os_handler(const struct usbd_context *ctx,const struct usb_setup_packet *setup)
{
    if(setup->bRequest!=0x20 || setup->wIndex!=MS_OS_20_DESCRIPTOR_INDEX) { return NULL; }
    uint16_t n=MIN(setup->wLength,sizeof(os));
    struct net_buf *buf=usbd_ep_ctrl_data_in_alloc(ctx,n);
    if(buf) { net_buf_add_mem(buf,&os,n); }
    return buf;
}
USBD_DESC_BOS_VREQ_DEFINE(msos,sizeof(bos),&bos,0x20,os_handler,NULL);
int ciso_usb_init(void)
{
    const char guid[]="{5D4E7C68-9BC1-4E2B-9D68-5C9AB801D9F2}";
    for(unsigned i=0;i<sizeof(guid)-1;i++) { os.guid.bPropertyData[i*2]=guid[i]; }
    int err;
    if((err=usbd_add_descriptor(&device,&lang)) ||
       (err=usbd_add_descriptor(&device,&manufacturer)) ||
       (err=usbd_add_descriptor(&device,&product)) ||
       (err=usbd_add_descriptor(&device,&serial)) ||
       (err=usbd_add_configuration(&device,USBD_SPEED_FS,&config)) ||
       (err=usbd_register_class(&device,"ciso_0",USBD_SPEED_FS,1)) ||
       (err=usbd_device_set_code_triple(&device,USBD_SPEED_FS,0,0,0)) ||
       (err=usbd_device_set_bcd_usb(&device,USBD_SPEED_FS,USB_SRN_2_0_1)) ||
       (err=usbd_add_descriptor(&device,&usbext)) ||
       (err=usbd_add_descriptor(&device,&msos)) ||
       (err=usbd_init(&device)) || (err=usbd_enable(&device))) { return err; }
    return 0;
}
bool ciso_usb_enabled(void) { return atomic_get(&enabled)!=0; }
struct net_buf *ciso_usb_read(k_timeout_t timeout) { return k_fifo_get(&out_fifo,timeout); }
void ciso_usb_read_done(struct net_buf *buf) { net_buf_unref(buf); out_start(); }
int ciso_usb_write(const uint8_t *bytes,size_t length)
{
    while(length) {
        if(!ciso_usb_enabled()) { return -ENODEV; }
        size_t n=MIN(length,64);
        struct net_buf *buf=usbd_ep_buf_alloc(class_data,desc.in.bEndpointAddress,n);
        if(!buf) { return -ENOMEM; }
        net_buf_add_mem(buf,bytes,n); k_sem_reset(&in_done);
        int err=usbd_ep_enqueue(class_data,buf);
        if(err) { net_buf_unref(buf); return err; }
        if(k_sem_take(&in_done,K_MSEC(1000))) {
            usbd_ep_dequeue(usbd_class_get_ctx(class_data),desc.in.bEndpointAddress);
            return -ETIMEDOUT;
        }
        if(atomic_get(&in_error)) { return atomic_get(&in_error); }
        bytes+=n; length-=n;
    }
    return 0;
}
```
