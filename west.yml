## west.yml
```yaml
manifest:
  projects:
    - name: zephyr
      url: https://github.com/zephyrproject-rtos/zephyr
      revision: 920074c07cf4b503f70670cf424e4add4325d05a
      path: zephyr
      import:
        name-allowlist:
          - cmsis_6
          - hal_stm32
    - name: cannectivity
      url: https://github.com/CANnectivity/cannectivity
      revision: 93eb616f21e270200846ffc20d128c57fdbe5dab
      path: modules/lib/cannectivity
  self:
    path: canable-vci
```
